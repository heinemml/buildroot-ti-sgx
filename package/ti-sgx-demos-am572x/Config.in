## package/ti-sgx-demos-am572x/Config.in
```kconfig
config BR2_PACKAGE_TI_SGX_DEMOS_AM572X
	bool "ti-sgx-demos-am572x"
	depends on BR2_PACKAGE_TI_SGX_UM_AM572X
	help
	  These SGX powervr demo applications from Imagination
	  Technologies are availabe as binaries only.  The binaries
	  are compiled for the TI SGX implementation.

	  https://git.ti.com/cgit/graphics/img-pvr-sdk
```

## package/ti-sgx-km-am572x/Config.in
```kconfig
comment "ti-sgx-km-am572x needs a Linux kernel to be built"
	depends on BR2_arm
	depends on !BR2_LINUX_KERNEL

config BR2_PACKAGE_TI_SGX_KM_AM572X
	bool "ti-sgx-km-am572x"
	depends on BR2_LINUX_KERNEL && BR2_arm
	select BR2_LINUX_NEEDS_MODULES
	help
	  Kernel modules for TI CPUs with SGX GPU.
	  This package supports AM572x only.
	  It builds the kernel module and the user space binaries.
	  For older CPUs or kernels use the ti-gfx package.

	  Note: it needs a TI specific kernel to build properly.

	  https://git.ti.com/cgit/graphics/omap5-sgx-ddk-linux
```

## package/ti-sgx-um-am572x/Config.in
```kconfig
comment "ti-sgx-um-am572x needs the ti-sgx-km-am572x driver"
	depends on !BR2_PACKAGE_TI_SGX_KM_AM572X

comment "ti-sgx-um-am572x needs udev and a glibc toolchain w/ threads"
	depends on !BR2_PACKAGE_HAS_UDEV || !BR2_TOOLCHAIN_USES_GLIBC \
		|| !BR2_TOOLCHAIN_HAS_THREADS

config BR2_PACKAGE_TI_SGX_UM_AM572X
	bool "ti-sgx-um-am572x"
	depends on BR2_PACKAGE_TI_SGX_KM_AM572X
	depends on BR2_TOOLCHAIN_HAS_THREADS # libdrm
	depends on BR2_PACKAGE_HAS_UDEV
	# pre-built binaries
	depends on BR2_TOOLCHAIN_USES_GLIBC
	select BR2_PACKAGE_LIBDRM
	select BR2_PACKAGE_LIBDRM_OMAP
	select BR2_PACKAGE_HAS_LIBEGL
	select BR2_PACKAGE_HAS_LIBEGL_WAYLAND
	select BR2_PACKAGE_HAS_LIBGLES
	select BR2_PACKAGE_HAS_POWERVR
	select BR2_PACKAGE_LIBFFI
	select BR2_PACKAGE_WAYLAND
	help
	  Graphics libraries for TI CPUs with SGX5xx GPU.
	  This package supports AM335x, AM437x, AM4430 and AM5430.
	  For older CPUs or kernels use the ti-gfx package.

	  https://git.ti.com/cgit/graphics/omap5-sgx-ddk-um-linux

if BR2_PACKAGE_TI_SGX_UM_AM572X

config BR2_PACKAGE_PROVIDES_LIBEGL
	default "ti-sgx-um-am572x"

config BR2_PACKAGE_PROVIDES_LIBGLES
	default "ti-sgx-um-am572x"

config BR2_PACKAGE_PROVIDES_POWERVR
	default "ti-sgx-um-am572x"

endif
```
